AUTOSAR XML (schema 00049)
package /Components/SwcImplementations
  swc implementation ACC_SWC_Impl: programming-language=C, sw-version=1.3.1, used-code-generator=Embedded Coder 7.9 (R2022b) 13-May-2022, vendor-id=0, behavior=ACC_SWC_IB
    code-descriptors:
      code Code
        artifact-descriptors:
          short-label=ACC_SWC_c, category=SWSRC
          short-label=ACC_SWC_h, category=SWHDR
          short-label=ACC_SWC_private_h, category=SWHDR
          short-label=ACC_SWC_types_h, category=SWHDR
          short-label=rtwtypes_h, category=SWHDR
    resource consumption RsrcCons_ACC_SWC
