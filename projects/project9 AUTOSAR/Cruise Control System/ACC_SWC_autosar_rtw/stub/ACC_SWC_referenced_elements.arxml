AUTOSAR XML (schema 00049)
standard types defined: boolean, uint8, uint16, uint32, sint8, sint16, sint32, float32, float64, void
package /AUTOSAR/Services/NvM
  client server interface NvMService: is-service=true  # Covers AUTOSAR_SWS_NVRAMManager.pdf V3.2.0 R4.0 Rev 3 - NVM734
    9 x operation, all with possible-error=NvMService/E_NOT_OK:
      GetDataIndex
        arg DataIndexPtr: category=VALUE, sw-calibration-access=READ-ONLY, type=uint8, direction=OUT
      SetDataIndex
        arg DataIndex: category=VALUE, sw-calibration-access=READ-ONLY, type=uint8, direction=IN
      SetRamBlockStatus
        arg BlockChanged: category=VALUE, sw-calibration-access=READ-ONLY, type=boolean, direction=IN
      ReadBlock
        arg DstPtr: category=DATA_REFERENCE, sw-calibration-access=READ-ONLY, type=NvM_DstPtrType, direction=IN
      WriteBlock
        arg SrcPtr: category=DATA_REFERENCE, sw-calibration-access=READ-ONLY, type=NvM_DstPtrType, direction=IN
      RestoreBlockDefaults
        arg DestPtr: category=DATA_REFERENCE, sw-calibration-access=READ-ONLY, type=NvM_DstPtrType, direction=IN
      EraseNvBlock
      InvalidateNvBlock
      GetErrorStatus
        arg RequestResultPtr: category=TYPE_REFERENCE, sw-calibration-access=READ-ONLY, type=NvM_RequestResultType, direction=OUT
    error E_NOT_OK: error-code=1
  impl type NvM_DstPtrType: category=DATA_REFERENCE, sw-pointer-target-props={target-category=VALUE, base-type=void}
  impl type NvM_RequestResultType: implementation-data-type=uint8
  client server interface NvMAdmin: is-service=true
    operation SetBlockProtection: possible-error=NvMAdmin/E_NOT_OK
      arg ProtectionEnabled: category=VALUE, sw-calibration-access=READ-ONLY, type=boolean, direction=IN
    error E_NOT_OK: error-code=1
