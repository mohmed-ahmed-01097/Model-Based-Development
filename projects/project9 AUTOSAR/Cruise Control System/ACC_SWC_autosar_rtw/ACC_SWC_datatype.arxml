AUTOSAR XML (schema 00049)
package /DataTypes
  impl type ACC_Mode: category=VALUE, base-type=sint32, compu {0=Accelerate, 1=Decelerate, 2=Stop, 3=Do_Nothing}
package /DataTypes/SwAddrMethods
  sw addr method CODE: section-type=CODE
  sw addr method CONST: section-type=CONST
  sw addr method VAR: section-type=VAR
package /DataTypes/Units
  unit NoUnit: factor-si-to-unit=1, offset-si-to-unit=0
