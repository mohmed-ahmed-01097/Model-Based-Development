AUTOSAR XML (schema 00049)
package /Interfaces
  10 x sender receiver interface:
    StartStopSw
      data StartStopSw: category=VALUE, sw-calibration-access=READ-ONLY, type=boolean
    CruiseSw
      data CruiseSw: category=VALUE, sw-calibration-access=READ-ONLY, type=boolean
    SetPoint
      data SetPoint: category=VALUE, sw-calibration-access=READ-ONLY, type=float32
    Ego_Velocity
      data Ego_Velocity: category=VALUE, sw-calibration-access=READ-ONLY, type=float32
    RelativeDistance
      data RelativeDistance: category=VALUE, sw-calibration-access=READ-ONLY, type=float32
    RelativeVelocity
      data RelativeVelocity: category=VALUE, sw-calibration-access=READ-ONLY, type=float32
    Fault
      data Fault: category=VALUE, sw-calibration-access=READ-ONLY, type=boolean
    Mode
      data Mode: category=VALUE, sw-calibration-access=READ-ONLY, type=ACC_Mode
    Acceleration
      data Acceleration: category=VALUE, sw-calibration-access=READ-ONLY, type=float32
    SafeDistance
      data SafeDistance: category=VALUE, sw-calibration-access=READ-ONLY, type=float32
