AUTOSAR XML (schema 00049)
package /Interfaces
  8 x sender receiver interface, all with is-service=true:
    Highway_Input_Signal
      data Highway_Input_Signal: category=VALUE, sw-calibration-access=READ-WRITE, type=UInt8
    Lane_Input_Signal
      data Lane_Input_Signal: category=VALUE, sw-calibration-access=READ-WRITE, type=UInt8
    Enable_Display
      data Enable_Display: category=VALUE, sw-calibration-access=READ-WRITE, type=UInt8
    Input_Switch
      data Input_Switch: category=VALUE, sw-calibration-access=READ-WRITE, type=UInt8
    Display_Mode_1
      data Display_Mode_1: category=VALUE, sw-calibration-access=READ-ONLY, type=UInt8
    Display_Mode_2
      data Display_Mode_2: category=VALUE, sw-calibration-access=READ-ONLY, type=UInt8
    Display_Mode_3
      data Display_Mode_3: category=VALUE, sw-calibration-access=READ-ONLY, type=UInt8
    Display_Mode_4
      data Display_Mode_4: category=VALUE, sw-calibration-access=READ-ONLY, type=UInt8
