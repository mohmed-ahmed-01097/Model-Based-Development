AUTOSAR XML (schema 00049)
package /Components/SwcImplementations
  swc implementation LCA_Impl: programming-language=C, sw-version=1.73.1, used-code-generator=Embedded Coder 7.9 (R2022b) 13-May-2022, vendor-id=0, behavior=LCA_IB
    code-descriptors:
      code Code
        artifact-descriptors:
          short-label=LCA_c, category=SWSRC
          short-label=LCA_Runabble_10ms_c, category=SWSRC
          short-label=LCA_h, category=SWHDR
          short-label=LCA_Runabble_10ms_h, category=SWHDR
          short-label=LCA_private_h, category=SWHDR
          short-label=LCA_types_h, category=SWHDR
          short-label=rtwtypes_h, category=SWHDR
    resource consumption RsrcCons_LCA
