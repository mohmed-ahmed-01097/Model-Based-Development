AUTOSAR XML (schema 00049)
package /Interfaces
  sender receiver interface RPortIn
    4 x data, all with category=VALUE, sw-calibration-access=READ-ONLY, type=UInt8:
      Enable_Display
      Highway_Input_Signal
      Input_Switch
      Lane_Input_Signal
  sender receiver interface PPortOut
    4 x data, all with category=VALUE, sw-calibration-access=READ-ONLY, type=UInt8:
      Display_Mode_{1..4}
